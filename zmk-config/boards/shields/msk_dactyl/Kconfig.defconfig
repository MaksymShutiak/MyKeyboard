## zmk-config/boards/shields/msk_dactyl/Kconfig.defconfig
```kconfig
if SHIELD_MSK_DACTYL_LEFT

config ZMK_KEYBOARD_NAME
    default "MSK Dactyl"

config ZMK_SPLIT_ROLE_CENTRAL
    default y

endif

if SHIELD_MSK_DACTYL_LEFT || SHIELD_MSK_DACTYL_RIGHT

config ZMK_SPLIT
    default y

endif
```

## zmk-config/boards/shields/msk_dactyl/Kconfig.shield
```kconfig
config SHIELD_MSK_DACTYL_LEFT
    def_bool $(shields_list_contains,msk_iris_left)

config SHIELD_MSK_DACTYL_RIGHT
    def_bool $(shields_list_contains,msk_iris_right)
```

## zmk-config/boards/shields/msk_iris/Kconfig.defconfig
```kconfig
if SHIELD_MSK_IRIS_LEFT

config ZMK_KEYBOARD_NAME
    default "MKS Iris"

config ZMK_SPLIT_ROLE_CENTRAL
    default y

endif

if SHIELD_MSK_IRIS_LEFT || SHIELD_MSK_IRIS_RIGHT

config ZMK_SPLIT
    default y

endif
```

## zmk-config/boards/shields/msk_iris/Kconfig.shield
```kconfig
config SHIELD_MSK_IRIS_LEFT
    def_bool $(shields_list_contains,msk_iris_left)

config SHIELD_MSK_IRIS_RIGHT
    def_bool $(shields_list_contains,msk_iris_right)
```

## zmk-config/boards/shields/msk_iris_v2/Kconfig.defconfig
```kconfig
if SHIELD_MSK_IRIS_V2_LEFT

config ZMK_KEYBOARD_NAME
    default "MKS Iris"

config ZMK_SPLIT_ROLE_CENTRAL
    default y

endif

if SHIELD_MSK_IRIS_V2_LEFT || SHIELD_MSK_IRIS_V2_RIGHT

config ZMK_SPLIT
    default y

endif
```

## zmk-config/boards/shields/msk_iris_v2/Kconfig.shield
```kconfig
config SHIELD_MSK_IRIS_V2_LEFT
    def_bool $(shields_list_contains,msk_iris_v2_left)

config SHIELD_MSK_IRIS_V2_RIGHT
    def_bool $(shields_list_contains,msk_iris_v2_right)
```

## zmk-config/boards/shields/msk_shift/Kconfig.defconfig
```kconfig
if SHIELD_MSK_SHIFT

config ZMK_KEYBOARD_NAME
    default "MKS Shift"

config SPI
    default y

endif
```

## zmk_dactyl_manuform_5_6_xiao/boards/shields/msk/Kconfig.defconfig
```kconfig
if SHIELD_MSK_LEFT

config ZMK_KEYBOARD_NAME
    default "Max Keyboard"

config ZMK_SPLIT_ROLE_CENTRAL
    default y

endif

if SHIELD_MSK_LEFT || SHIELD_MSK_RIGHT

config ZMK_SPLIT
    default y

endif
```

## zmk_dactyl_manuform_5_6_xiao/boards/shields/msk/Kconfig.shield
```kconfig
config SHIELD_MSK_LEFT
    def_bool $(shields_list_contains,msk_left)

config SHIELD_MSK_RIGHT
    def_bool $(shields_list_contains,msk_right)
```
